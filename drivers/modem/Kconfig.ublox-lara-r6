## drivers/modem/Kconfig.ublox-lara-r6
```kconfig
# u-blox LARA-R6/R211 driver options

# Copyright (c) 2014 Bert Outtier
# SPDX-License-Identifier: Apache-2.0

config MODEM_UBLOX_LARA
	bool "U-blox LARA modem driver"
	select MODEM_CONTEXT
	select MODEM_CMD_HANDLER
	select MODEM_IFACE_UART
	select MODEM_SOCKET
	select NET_OFFLOAD
	select NET_SOCKETS_OFFLOAD
	help
	  Choose this setting to enable u-blox LARA-R6 or LARA-R211
	  LTE-Cat1 modem driver.

if MODEM_UBLOX_LARA

choice MODEM_UBLOX_LARA_VARIANT
	bool "u-blox SARA variant selection"
	default MODEM_UBLOX_LARA_R6

config MODEM_UBLOX_LARA_R6
	bool "u-blox LARA-R6"
	help
	  Enable support for LARA-R6 modem

endchoice

config MODEM_UBLOX_LARA_R6_RX_STACK_SIZE
	int "Stack size for the u-blox LARA-R6 modem driver RX thread"
	default 1028
	help
	  This stack is used by the u-blox LARA-R6 RX thread.

config MODEM_UBLOX_LARA_R6_APN
	string "APN for establishing network connection"
	default "hologram"
	help
	  This setting is used in the AT+CGDCONT command to set the APN name
	  for the network connection context.  This value is specific to
	  the network provider and may need to be changed.

config MODEM_UBLOX_LARA_AUTODETECT_APN
	bool "detect APN automatically"
	help
	  Enable automatic detection of the APN, based on the IMSI
	  If the detection fails, the configured APN will be used

config MODEM_UBLOX_LARA_R6_INIT_PRIORITY
	int "u-blox LARA-R6 driver init priority"
	default 80
	help
	  u-blox LARA-R6 device driver initialization priority.
	  Do not mess with it unless you know what you are doing.
	  Note that the priority needs to be lower than the net stack
	  so that it can start before the networking sub-system.


endif # MODEM_UBLOX_LARA
```

## dts/bindings/modem/u-blox,lara-r6.yaml
```yaml
# Copyright (c) 2024 Bert Outtier
# SPDX-License-Identifier: Apache-2.0

description: u-blox LARA-R6 modem

compatible: "u-blox,lara-r6"

include: uart-device.yaml

properties:
  mdm-power-gpios:
    type: phandle-array

  mdm-reset-gpios:
    type: phandle-array

  mdm-dtr-gpios:
    type: phandle-array
```
